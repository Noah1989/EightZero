; special key characters
DEFC K_ESC	= 0x1B
DEFC K_CPL	= 0x80 ; caps lock
DEFC K_F1	= 0x81
DEFC K_F2	= 0x82
DEFC K_F3	= 0x83
DEFC K_F4	= 0x84
DEFC K_F5	= 0x85
DEFC K_F6	= 0x86
DEFC K_F7	= 0x87
DEFC K_F8	= 0x88
DEFC K_F9	= 0x89
DEFC K_F10	= 0x8A
DEFC K_F11	= 0x8B
DEFC K_F12	= 0x8C
DEFC K_UPA	= 0x8D ; up arrow
DEFC K_LFA	= 0x8E ; left arrow
DEFC K_DNA	= 0x8F ; down arrow
DEFC K_RTA	= 0x90 ; right arrow
DEFC K_INS	= 0x91 ; insert
DEFC K_DEL	= 0x92 ; delete
DEFC K_HOM	= 0x93 ; home
DEFC K_END	= 0x94 ; end
DEFC K_PGU	= 0x95 ; page up
DEFC K_PGD	= 0x96 ; page down
DEFC K_NML	= 0x97 ; num lock
DEFC K_SCL	= 0x98 ; scroll lock
DEFC K_PRS	= 0x99 ; print screen
DEFC K_BRK	= 0x9A ; break
